## config/boards/shields/duckboard/Kconfig.defconfig
```kconfig
# Copyright (c) 2021 The ZMK Contributors
# SPDX-License-Identifier: MIT
# Author: Jack Hartstein

if SHIELD_DUCKBOARD

config ZMK_KEYBOARD_NAME
    default "duckboard"

config ZMK_USB
    default y

config ZMK_BLE
    default y

if ZMK_DISPLAY
config I2C
    default y
config SSD1306
    default y
endif

if LVGL
config LV_Z_VDB_SIZE
    default 64
config LV_DPI_DEF
    default 148
config LV_Z_BITS_PER_PIXEL
    default 1
choice LV_COLOR_DEPTH
    default LV_COLOR_DEPTH_1
endchoice
endif

endif
```
